## sdkconfig.defaults
```kconfig
# Hardware profile: ESP32 with 4MB flash and no PSRAM
CONFIG_FREERTOS_HZ=1000
CONFIG_ESPTOOLPY_FLASHSIZE_4MB=y
CONFIG_ESPTOOLPY_FLASHSIZE="4MB"
CONFIG_SPI_FLASH_SUPPORT_BOYA_CHIP=y
# CONFIG_SPIRAM is not set
CONFIG_PARTITION_TABLE_SINGLE_APP_LARGE=y
CONFIG_PARTITION_TABLE_FILENAME="partitions_singleapp_large.csv"
CONFIG_COMPILER_DISABLE_DEFAULT_ERRORS=y
CONFIG_MBEDTLS_PSK_KEY_EXCHANGE_ENABLED=y
CONFIG_LV_COLOR_16_SWAP=y
CONFIG_LV_FONT_MONTSERRAT_14=y
CONFIG_LV_FONT_MONTSERRAT_16=y
CONFIG_LV_FONT_MONTSERRAT_20=y
CONFIG_LV_FONT_MONTSERRAT_24=y
CONFIG_LV_FONT_MONTSERRAT_28=y
CONFIG_LV_FONT_MONTSERRAT_32=y
CONFIG_LV_FONT_DEFAULT_MONTSERRAT_16=y
```
